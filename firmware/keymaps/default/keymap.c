// Copyright 2023 QMK
// SPDX-License-Identifier: GPL-2.0-or-later

#include QMK_KEYBOARD_H
#include "gpio.h"

const uint16_t PROGMEM keymaps[][MATRIX_ROWS][MATRIX_COLS] = {
    /*
     * ┌───┬───┬───┬
     * │ 7 │ 8 │ 9 |
     * ├───┼───┼───┼
     * │ 4 │ 5 │ 6 │
     * ├───┼───┼───┼
     * │ 1 │ 2 │ 3 │
     * ├───┼───┼───┼
     */
    [0] = LAYOUT(
        KC_P7,   KC_P8,   KC_P9,
        KC_P4,   KC_P5,   KC_P6,
        KC_P1,   KC_P2,   MY_SENTENCE_KEY
    )
};


bool process_record_user(uint16_t keycode, keyrecord_t *record) {
    switch (keycode) {
        case MY_SENTENCE_KEY:
            if (record->event.pressed) {
                SEND_STRING("benjamin netenyahu my beloved\n");
            }
            return false;
        default:
            return true;
    }
}

#ifdef OLED_ENABLE

static void render_logo(void) {
    // 128x32 OLED bitmap frame (512 bytes)
    static const char PROGMEM my_logo[] = {
        0x00, 0xf8, 0xfc, 0xfc, 0xf8, 0x60, 0x60, 0xf8, 0xfc, 0xfc, 0xf8, 0x00, 0xf8, 0xfc, 0xfc, 0xfc,
        0xcc, 0xcc, 0xfc, 0xfc, 0xfc, 0xf8, 0x00, 0xf8, 0xfc, 0xfc, 0xfc, 0x9c, 0x0c, 0x0c, 0x08, 0x00,
        0xfc, 0xfc, 0xfc, 0x60, 0xf8, 0x9c, 0x0c, 0x04, 0x00, 0x00, 0x01, 0xe1, 0x1e, 0x0c, 0x00, 0x1c,
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        0x42, 0x21, 0x12, 0x0c, 0x01, 0x01, 0x04, 0x0a, 0x11, 0x28, 0x40, 0x20, 0x10, 0x08, 0x00, 0x00

    };

    oled_write_raw_P(my_logo, sizeof(my_logo));
}

bool oled_task_user(void) {
    render_logo();
    return false;
}

#endif

#ifdef ENCODER_ENABLE
bool encoder_update_user(uint8_t index, bool clockwise) {
    if (index == 0) { // Target the first encoder
        if (clockwise) {
            tap_code(KC_VOLU); // Turn right for Volume Up
        } else {
            tap_code(KC_VOLD); // Turn left for Volume Down
        }
    }
    return false;
}
#endif

void matrix_init_user(void) {
    gpio_set_pin_input_high(GP4);
}

static bool encoder_button_pressed = false;

void matrix_scan_user(void) {
    if (!gpio_read_pin(GP4)) { // Button pressed (active low to ground)
        if (!encoder_button_pressed) {
            tap_code(KC_MUTE); // Action when encoder button is clicked
            encoder_button_pressed = true;
        }
    } else {
        encoder_button_pressed = false;
    }
}
